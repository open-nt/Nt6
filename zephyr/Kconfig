## zephyr/Kconfig
```kconfig
# MIT License - see LICENSE

menuconfig NT
	bool "Nt, a clean-room subset of the Qt 6 API"
	depends on CPP
	select REQUIRES_FULL_LIBCPP
	select CPP_EXCEPTIONS
	select CPP_RTTI
	select POSIX_API
	select EVENTFD
	select POSIX_FILE_SYSTEM
	select THREAD_LOCAL_STORAGE
	# Nt writes a number with decimals through vsnprintf(); without floating point in printf, picolibc prints
	# "*float*" in its place. This leaves PICOLIBC_IO_FLOAT as the only level of its printf that is available.
	select REQUIRES_FLOAT_PRINTF
	select DYNAMIC_THREAD
	select DYNAMIC_THREAD_ALLOC
	select POSIX_PRIORITY_SCHEDULING
	help
	  Builds Nt Core for the application: QObject with signals and slots, the event loop,
	  timers, threads, the containers and strings, JSON, XML and the item models. Link the
	  application with Nt::Core.

	  Nt uses C++17, exceptions, run-time type information, POSIX threads and the heap. It suits
	  devices with megabytes of flash and RAM, such as the i.MX RT series, not small
	  microcontrollers.

if NT

config NT_THREAD_STACK_SIZE
	int "Stack size of the threads that Nt starts"
	default 8192
	help
	  The stack size, in bytes, of a QThread that was given none with QThread::setStackSize(),
	  of the threads of a QThreadPool and of the threads that Nt starts for itself, such as the
	  one that resolves a host name. The stacks are allocated from the kernel heap
	  (CONFIG_HEAP_MEM_POOL_SIZE).

config NT_HOME_PATH
	string "Home directory of Nt"
	default "/lfs"
	help
	  What QDir::homePath() returns, unless the environment variable HOME is set. The
	  locations of QStandardPaths and the files of QSettings are below it (QSettings writes
	  <home>/.config/<organization>/<application>.conf), and QDir::tempPath() is its directory
	  tmp. It has to be on a mounted file system, such as the one CONFIG_NT_STORAGE mounts.

config NT_STORAGE
	bool "Mount LittleFS at the home directory"
	depends on $(dt_nodelabel_exists,storage_partition)
	select FLASH
	select FLASH_MAP
	select FILE_SYSTEM
	select FILE_SYSTEM_LITTLEFS
	help
	  Mounts LittleFS on the flash partition labelled storage_partition at NT_HOME_PATH before
	  main() runs, formatting the partition if it holds no LittleFS yet. QFile, QSaveFile,
	  QSettings and QStandardPaths then keep their files across a reboot. Leave it off when the
	  devicetree's fstab mounts a file system there instead.

config ZVFS_EVENTFD_ADD_SIZE_NT
	int "Number of eventfds needed by Nt"
	default 16 if NT_GPIO && NT_SERIALPORT
	default 12 if NT_GPIO
	default 8 if NT_SERIALPORT
	default 4
	help
	  The event loop of each thread that runs one (the main thread and each QThread) wakes up
	  through an eventfd, and so does each QGpioLine input whose pin has an interrupt; an open
	  QSerialPort takes two. Zephyr's
	  default of one eventfd in all leaves no more after the main thread, and an input line is
	  then polled instead of woken by its interrupt. Each eventfd also takes a file descriptor.

config NT_NETWORK
	bool "Nt Network"
	depends on NETWORKING
	depends on NET_SOCKETS
	help
	  Builds Nt Network: QTcpSocket, QTcpServer, QUdpSocket, QHostAddress, QHostInfo and
	  QNetworkAccessManager for http:. Link the application with Nt::Network.

	  QLocalSocket and QLocalServer are not available on Zephyr.

config NT_DEVICE
	bool "Nt Device (watchdog and firmware updates)"
	help
	  Builds Nt Device: QWatchdog on the watchdog drivers (CONFIG_WATCHDOG, with the reset cause
	  from CONFIG_HWINFO) and QFirmwareUpdate, which writes a new image into slot1_partition for
	  MCUboot (CONFIG_IMG_MANAGER, CONFIG_MCUBOOT_IMG_MANAGER, CONFIG_STREAM_FLASH) and reboots into
	  it (CONFIG_REBOOT). A part whose options are not set fails with UnsupportedOperationError.
	  Link the application with Nt::Device.

config NT_MQTT
	bool "Nt Mqtt"
	depends on NT_NETWORK
	help
	  Builds Nt Mqtt: QMqttClient, which publishes messages to an MQTT broker and subscribes to
	  topics, with MQTT 3.1.1 over TCP and, with CONFIG_NT_TLS, over TLS. Link the application
	  with Nt::Mqtt.

config NT_GPIO
	bool "Nt GPIO"
	depends on GPIO
	help
	  Builds Nt GPIO: QGpioLine, which reads and drives GPIO pins, such as a push-to-talk
	  switch or an LED, from the event loop. Pins are named "<controller>:<pin>", with the
	  controller's node label or the device name that device_get_binding() takes (gpio9:3), or
	  by the alias or node label of an LED or key of the board (led0, sw0). Link the
	  application with Nt::Gpio.

	  QPwmChannel, QAnalogInput, QAnalogOutput, QI2cDevice and QSpiDevice work when CONFIG_PWM,
	  CONFIG_ADC, CONFIG_DAC, CONFIG_I2C and CONFIG_SPI are set; without one, that class fails
	  open() with UnsupportedOperationError.

config NT_SERIALPORT
	bool "Nt SerialPort"
	depends on SERIAL
	depends on SERIAL_SUPPORT_INTERRUPT
	select UART_INTERRUPT_DRIVEN
	help
	  Builds Nt SerialPort: QSerialPort and QSerialPortInfo on the UART drivers of Zephyr, for a
	  GPS receiver, a modem or a radio. A port is named by the node label of its UART (lpuart2)
	  or by its device name (serial@40080000); availablePorts() lists every UART. Runtime
	  configuration (CONFIG_UART_USE_RUNTIME_CONFIGURE, on by default) sets the baud rate, data
	  bits, parity, stop bits and RTS/CTS flow control; CONFIG_UART_LINE_CTRL adds DTR and RTS
	  where the driver has them. Link the application with Nt::SerialPort.

	  Do not open the UART of the console or the shell: the port takes its interrupts over.

if NT_SERIALPORT

config NT_SERIALPORT_BUFFER_SIZE
	int "Size of each of the receive and transmit buffers of a port, in bytes"
	default 1024
	help
	  The interrupt handler moves bytes between the UART and these buffers, which hold what
	  arrives until the event loop reads it. Bytes that arrive when the receive buffer is full
	  are lost: at 115200 baud, 1024 bytes last about 90 ms.

endif # NT_SERIALPORT

config NT_SERIALBUS
	bool "Nt SerialBus (CAN)"
	depends on CAN
	help
	  Builds the CAN part of Nt SerialBus: QCanBus, QCanBusDevice and QCanBusFrame, on the CAN
	  drivers of Zephyr (the backend zephyrcan) and on a virtual bus inside the application
	  (virtualcan). A controller is named "canbus" for the one that zephyr,canbus chooses, by an
	  alias can0 to can3, or by its device name, such as can@40c3c000. Link the application with
	  Nt::SerialBus.

config NT_SENSORS
	bool "Nt Sensors"
	depends on SENSOR
	help
	  Builds Nt Sensors: QSensor, QAccelerometer, QGyroscope, QMagnetometer, QPressureSensor,
	  QAmbientTemperatureSensor, QHumiditySensor and QLightSensor, on the sensor drivers of
	  Zephyr. The sensors listed are those of the devicetree aliases accel0, gyro0, magn0,
	  press0, ambient-temp0, die-temp0, humidity0 and light0; others are named by their device
	  name. Link the application with Nt::Sensors.

config NT_MULTIMEDIA
	bool "Nt Multimedia (audio)"
	depends on I2S
	depends on AUDIO_CODEC
	depends on I2C
	imply NOCACHE_MEMORY if ARCH_HAS_NOCACHE_MEMORY_SUPPORT
	help
	  Builds the audio part of Nt Multimedia: QAudioSink, QAudioSource, QAudioInput,
	  QAudioOutput, QSoundEffect, QAudioDecoder, QMediaDevices and QAudioHeadset, which sets the
	  bias and gain of a headset microphone and senses it and its button. Link the application
	  with Nt::Multimedia.

	  Audio goes through the I2S controller that the devicetree alias i2s-codec-tx names and the
	  codec labelled audio_codec, as on the MIMXRT1170-EVKB with its WM8962. QAudioHeadset
	  controls the WM8962. Cameras, video and QMediaPlayer are not built (QT_NO_CAMERA).

if NT_MULTIMEDIA

config NT_AUDIO_BLOCK_SIZE
	int "Size of an audio DMA block, in bytes"
	default 3840
	help
	  Each block holds 10 ms of stereo samples on the I2S bus. The default holds 48 kHz with
	  32-bit words; 1920 is enough for 48 kHz with 16-bit samples. Must be a multiple of 32.

config NT_AUDIO_BLOCK_COUNT
	int "Number of audio DMA blocks for playing"
	default 4
	help
	  The blocks queued for the I2S transmitter, which set the latency of playing at 10 ms
	  each; recording has four more. They are kept in memory that the data cache does not cover.

endif # NT_MULTIMEDIA

config NT_FM
	bool "Nt FM (FM synthesiser for sound effects and music)"
	imply NT_MULTIMEDIA if I2S && AUDIO_CODEC && I2C
	# The synthesiser renders in single-precision floating point.
	imply FPU
	# An engine without a seed of its own takes one from QRandomGenerator::global(), which reads getentropy().
	imply ENTROPY_GENERATOR
	help
	  Builds Nt FM: QtFM::Engine, which synthesises sound effects and plays music (MIDI files
	  and OPL register logs) with four-operator FM in real time, from patches of a few
	  hundred bytes instead of sample files. Link the application with Nt::FM.

	  With CONFIG_NT_MULTIMEDIA, Engine::start() plays through the audio codec, as on the
	  MIMXRT1170-EVKB with its WM8962, in stereo with 16-bit samples; the engine's sample rate
	  has to be one the codec runs at, such as the default of 48000 Hz. Without it, the engine
	  renders offline or into an AudioOutput of the application's own. VGZ (gzipped VGM) is
	  not read.

	  The synthesiser renders in floating point, so CONFIG_FPU is implied, and an engine whose
	  EngineConfig has no seed draws one from the board's entropy driver (CONFIG_ENTROPY_GENERATOR).

config NT_HTTPSERVER
	bool "HTTP server and WebSockets"
	depends on NT_NETWORK
	help
	  Builds Nt HTTP Server and Nt WebSockets: QHttpServer with routing, JSON and file responses,
	  chunked replies and WebSocket upgrades, and QWebSocket and QWebSocketServer. Link the
	  application with Nt::HttpServer or Nt::WebSockets. With CONFIG_NT_TLS they also serve and
	  connect over TLS.

config NT_TLS
	bool "TLS for Nt Network, with Mbed TLS"
	depends on NT_NETWORK
	select PSA_CRYPTO
	select MBEDTLS
	select MBEDTLS_SSL_PROTO_TLS1_2
	select MBEDTLS_X509_CRT_PARSE_C
	select MBEDTLS_PK_PARSE_C
	select MBEDTLS_PK_WRITE_C
	select MBEDTLS_PEM_PARSE_C
	select MBEDTLS_SSL_ALPN
	select MBEDTLS_SSL_SERVER_NAME_INDICATION
	imply MBEDTLS_CIPHERSUITE_TLS_ECDHE_ECDSA_WITH_AES_128_GCM_SHA256
	imply MBEDTLS_CIPHERSUITE_TLS_ECDHE_RSA_WITH_AES_128_GCM_SHA256
	imply MBEDTLS_CIPHERSUITE_TLS_ECDHE_ECDSA_WITH_AES_256_GCM_SHA384
	imply MBEDTLS_CIPHERSUITE_TLS_ECDHE_RSA_WITH_AES_256_GCM_SHA384
	help
	  Builds QSslSocket, QSslServer, QSslCertificate, QSslKey and QSslConfiguration on Mbed TLS,
	  and with them https: in QNetworkAccessManager. Without this option QT_NO_SSL is defined
	  and the classes are absent.

	  TLS 1.2 is enabled with the ECDHE ciphers of AES-GCM; add other versions and ciphers
	  with the options of Mbed TLS, such as CONFIG_MBEDTLS_SSL_PROTO_TLS1_3. Mbed TLS takes its
	  random numbers from PSA, which needs an entropy source on the board, and it checks the
	  dates of certificates only with CONFIG_MBEDTLS_HAVE_TIME_DATE and a clock that is set.

endif # NT

# The event loop of a thread waits in one poll() for all of its sockets. Zephyr counts what poll() waits for (a
# connected TCP socket takes two events, one for reading and one for writing) and fails above this limit, whose default
# of 3 is used up by a single connection. Nt copes with any limit of 3 or more, by polling in groups, but each group
# adds up to 10 ms of delay for the sockets in the others, so a higher limit gives lower latency with many sockets.
# The kernel keeps this many events on the stack of the thread that polls.
config ZVFS_POLL_MAX
	default 16 if NT
```

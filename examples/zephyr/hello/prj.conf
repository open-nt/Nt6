## CMakeLists.txt
```
# MIT License - see LICENSE
#
# A Zephyr application that uses Nt Core and Nt Network. Build it with west, for example:
#
#   west build -b mimxrt1170_evk/mimxrt1176/cm7 examples/zephyr/hello
cmake_minimum_required(VERSION 3.20)

# Nt is used straight from this repository. An application of its own lists Nt in its west manifest
# instead, and needs neither of these lines.
get_filename_component(NT_ROOT ${CMAKE_CURRENT_LIST_DIR}/../../.. ABSOLUTE)
list(APPEND ZEPHYR_EXTRA_MODULES ${NT_ROOT})

find_package(Zephyr REQUIRED HINTS $ENV{ZEPHYR_BASE})
project(nt_zephyr_hello LANGUAGES CXX)

target_sources(app PRIVATE src/main.cpp)
target_link_libraries(app PRIVATE Nt::Core Nt::Network)
```

## prj.conf
```kconfig
# Nt needs C++17 with the full standard library; CONFIG_NT selects the rest.
CONFIG_CPP=y
CONFIG_STD_CPP17=y
CONFIG_NT=y
CONFIG_NT_NETWORK=y

# Nt allocates from the C library's heap, and its event loop runs on the main thread.
CONFIG_COMMON_LIBC_MALLOC_ARENA_SIZE=1048576
CONFIG_MAIN_STACK_SIZE=16384
# The stacks of the threads that Nt starts (CONFIG_NT_THREAD_STACK_SIZE each) come from the kernel heap.
CONFIG_HEAP_MEM_POOL_SIZE=65536

CONFIG_NETWORKING=y
CONFIG_NET_IPV4=y
CONFIG_NET_TCP=y
CONFIG_NET_UDP=y
CONFIG_NET_SOCKETS=y
CONFIG_NET_DHCPV4=y
CONFIG_NET_CONFIG_SETTINGS=y
CONFIG_NET_CONFIG_NEED_IPV4=y
CONFIG_ZVFS_OPEN_MAX=32
```

## src/main.cpp
```c
// MIT License - see LICENSE
// Nt on Zephyr: a timer and a TCP echo server on one event loop.
#include <QtCore/QCoreApplication>
#include <QtCore/QDebug>
#include <QtCore/QTimer>
#include <QtNetwork/QTcpServer>
#include <QtNetwork/QTcpSocket>

int main() {
    int argc = 1;
    char name[] = "hello";
    char *argv[] = {name, nullptr};
    QCoreApplication app(argc, argv);

    QTimer heartbeat;
    int beats = 0;
    QObject::connect(&heartbeat, &QTimer::timeout, [&beats] { qInfo() << "heartbeat" << ++beats; });
    heartbeat.start(1000);

    QTcpServer server;
    QObject::connect(&server, &QTcpServer::newConnection, [&server] {
        QTcpSocket *client = server.nextPendingConnection();
        QObject::connect(client, &QTcpSocket::readyRead, [client] { client->write(client->readAll()); });
        QObject::connect(client, &QTcpSocket::disconnected, client, &QObject::deleteLater);
    });
    if (!server.listen(QHostAddress::Any, 4242))
        qWarning() << "listen failed:" << server.errorString();
    else
        qInfo() << "echo server on port" << server.serverPort();

    return app.exec();
}
```

## CMakeLists.txt
```
# MIT License - see LICENSE
#
# Nt on an emulated board: a self-checking application that needs no hardware, and a web page with its results.
# The checks use the loopback interface, so they need no network set up. Build and run it with west:
#
#   west build -b mps2/an385 examples/zephyr/qemu -t run
cmake_minimum_required(VERSION 3.20)

# Nt is used straight from this repository. An application of its own lists Nt in its west manifest
# instead, and needs neither of these lines.
get_filename_component(NT_ROOT ${CMAKE_CURRENT_LIST_DIR}/../../.. ABSOLUTE)
list(APPEND ZEPHYR_EXTRA_MODULES ${NT_ROOT})

find_package(Zephyr REQUIRED HINTS $ENV{ZEPHYR_BASE})
project(nt_zephyr_qemu LANGUAGES CXX)

target_sources(app PRIVATE src/main.cpp src/webpage.cpp src/board.cpp)
target_link_libraries(app PRIVATE Nt::Core Nt::Network)
if(CONFIG_NT_HTTPSERVER)
    target_link_libraries(app PRIVATE Nt::HttpServer)
endif()
```

## prj.conf
```kconfig
# Nt needs C++17 with the full standard library; CONFIG_NT selects the rest.
CONFIG_CPP=y
CONFIG_STD_CPP17=y
CONFIG_NT=y
CONFIG_NT_NETWORK=y
CONFIG_NT_HTTPSERVER=y
CONFIG_NT_TLS=y

# Nt allocates from the C library's heap, and its event loop runs on the main thread. The stacks of
# the threads that Nt starts come from the kernel heap.
CONFIG_COMMON_LIBC_MALLOC_ARENA_SIZE=1048576
CONFIG_MAIN_STACK_SIZE=16384
# Fills the stacks with a known pattern, so that the page can tell how much of one was ever used.
CONFIG_INIT_STACKS=y
CONFIG_HEAP_MEM_POOL_SIZE=131072

# TCP over the loopback interface: the application talks to itself.
CONFIG_NETWORKING=y
CONFIG_NET_IPV4=y
CONFIG_NET_IPV6=n
CONFIG_NET_TCP=y
CONFIG_NET_UDP=y
CONFIG_NET_SOCKETS=y
CONFIG_NET_LOOPBACK=y

# The Ethernet controller of the emulated board, on the network that QEMU's user mode provides: the board is
# 10.0.2.15 behind the gateway 10.0.2.2, and QEMU can forward a port of the host to the web page.
CONFIG_NET_CONFIG_SETTINGS=y
CONFIG_NET_CONFIG_NEED_IPV4=y
CONFIG_NET_CONFIG_MY_IPV4_ADDR="10.0.2.15"
CONFIG_NET_CONFIG_MY_IPV4_NETMASK="255.255.255.0"
CONFIG_NET_CONFIG_MY_IPV4_GW="10.0.2.2"
CONFIG_ZVFS_OPEN_MAX=32
# Two servers, three clients and the three connections that the servers accept.
CONFIG_NET_MAX_CONTEXTS=16
CONFIG_NET_MAX_CONN=16
CONFIG_NET_PKT_RX_COUNT=32
CONFIG_NET_PKT_TX_COUNT=32
CONFIG_NET_BUF_RX_COUNT=64
CONFIG_NET_BUF_TX_COUNT=64

# The emulated board has no entropy source; never use this on a real device.
CONFIG_TEST_RANDOM_GENERATOR=y
```

## src/main.cpp
```c
// MIT License - see LICENSE
// Nt on Zephyr under QEMU: exercises the event loop, timers, JSON, a TCP and a TLS connection over the
// loopback interface and a worker thread, prints PASS or FAIL, and serves a web page with the results from
// port 8080, which QEMU can forward to the host (see doc/zephyr.h).
#include <QtCore/QCoreApplication>
#include <QtCore/QDebug>
#include <QtCore/QJsonDocument>
#include <QtCore/QJsonObject>
#include <QtCore/QThread>
#include <QtCore/QTimer>
#include <QtNetwork/QTcpServer>
#include <QtNetwork/QTcpSocket>
#ifndef QT_NO_SSL
#include <QtNetwork/QSslConfiguration>
#include <QtNetwork/QSslServer>
#include <QtNetwork/QSslSocket>
#endif

#include "board.h"
#include "webpage.h"

#include <cstdio>

namespace {

int g_failures = 0;

void check(bool ok, const char *what, const QString &detail = QString()) {
    std::printf("  %-34s %s\n", what, ok ? "ok" : "FAILED");
    recordResult(QString::fromUtf8(what), ok, detail);
    if (!ok)
        ++g_failures;
}

#ifndef QT_NO_SSL
// A self-signed certificate for "localhost" and its key, made for this sample only. A key that is published
// like this one protects nothing: a product provisions its own.
const char kCertificate[] = "-----BEGIN CERTIFICATE-----\n"
                            "MIIBwzCCAWmgAwIBAgIUEYiBkzEWT3q28i3qL7vmV9bPVHQwCgYIKoZIzj0EAwIw\n"
                            "KDESMBAGA1UEAwwJbG9jYWxob3N0MRIwEAYDVQQKDAlOdCBzYW1wbGUwIBcNMjYx\n"
                            "MTExMTkwMTI0WhgPMjEyNjEwMTgxOTAxMjRaMCgxEjAQBgNVBAMMCWxvY2FsaG9z\n"
                            "dDESMBAGA1UECgwJTnQgc2FtcGxlMFkwEwYHKoZIzj0CAQYIKoZIzj0DAQcDQgAE\n"
                            "3YSYJZRxhsaL1Hykv32HYqXmq3u1ceDIG+W1itvXrsrLS7We6H028d7ney3DfQ97\n"
                            "nC/KGxbJuEg+BbJFNsuPp6NvMG0wHQYDVR0OBBYEFH4J0fpFAzvsIhYxewr5x1V9\n"
                            "qOjWMB8GA1UdIwQYMBaAFH4J0fpFAzvsIhYxewr5x1V9qOjWMA8GA1UdEwEB/wQF\n"
                            "MAMBAf8wGgYDVR0RBBMwEYIJbG9jYWxob3N0hwR/AAABMAoGCCqGSM49BAMCA0gA\n"
                            "MEUCIEFUK3+MUDAtJbxOATnWeZry7X83NyeERjUkwmFy4S3QAiEAuSozXhei3DgP\n"
                            "1HgYW3X965EcSrgajueRSOEFEEWTKrE=\n"
                            "-----END CERTIFICATE-----\n";
const char kPrivateKey[] = "-----BEGIN PRIVATE KEY-----\n"
                           "MIGHAgEAMBMGByqGSM49AgEGCCqGSM49AwEHBG0wawIBAQQgKdEgDazo+ur/ciNQ\n"
                           "lDuc2MmBi8VtDhGPMTUtz4viDkChRANCAATdhJgllHGGxovUfKS/fYdipeare7Vx\n"
                           "4Mgb5bWK29euystLtZ7ofTbx3ud7LcN9D3ucL8obFsm4SD4FskU2y4+n\n"
                           "-----END PRIVATE KEY-----\n";
#endif

} // namespace

int main() {
    int argc = 1;
    char name[] = "nt_qemu";
    char *argv[] = {name, nullptr};
    QCoreApplication app(argc, argv);
    std::printf("Nt %s on Zephyr\n", qVersion());

    limitEthernetFrames(); // see board.h

    // The web page comes first, so that it can be opened while the checks run, and shows them as they finish.
    QString webError;
    if (startWebServer(8080, &webError))
        std::printf("  web page on port 8080\n");
    else
        std::printf("  no web page: %s\n", qPrintable(webError));

    // Strings and JSON, with no event loop involved.
    QJsonObject object;
    object.insert(QString("board"), QString("qemu"));
    object.insert(QString("answer"), 42);
    const QByteArray json = QJsonDocument(object).toJson(QJsonDocument::Compact);
    const QJsonObject parsed = QJsonDocument::fromJson(json).object();
    check(parsed.value(QString("answer")).toInt() == 42 && parsed.value(QString("board")).toString() == QString("qemu"),
          "JSON round trip");

    // A repeating timer.
    int ticks = 0;
    QTimer ticker;
    QObject::connect(&ticker, &QTimer::timeout, [&ticks] { ++ticks; });
    ticker.start(50);

    // A TCP echo server and a client that talks to it over the loopback interface.
    QTcpServer server;
    QObject::connect(&server, &QTcpServer::newConnection, [&server] {
        QTcpSocket *peer = server.nextPendingConnection();
        QObject::connect(peer, &QTcpSocket::readyRead, [peer] { peer->write(peer->readAll()); });
        QObject::connect(peer, &QTcpSocket::disconnected, peer, &QObject::deleteLater);
    });
    const bool listening = server.listen(QHostAddress(QString("127.0.0.1")), 4242);
    check(listening, "QTcpServer::listen");

    const QByteArray message("hello from Nt");
    QByteArray echoed;
    QTcpSocket client;
    QObject::connect(&client, &QTcpSocket::connected, [&] { client.write(message); });
    QObject::connect(&client, &QTcpSocket::readyRead, [&] { echoed += client.readAll(); });
    client.connectToHost(QHostAddress(QString("127.0.0.1")), 4242);

#ifndef QT_NO_SSL
    // The same over TLS: the server presents the certificate, and the client trusts exactly that one and
    // checks that it was issued to "localhost".
    const QSslCertificate certificate(QByteArray(kCertificate), QSsl::Pem);
    const QSslKey privateKey(QByteArray(kPrivateKey), QSsl::Ec, QSsl::Pem);
    check(!certificate.isNull() &&
              certificate.subjectInfo(QSslCertificate::CommonName).value(0) == QString("localhost"),
          "QSslCertificate from PEM");
    check(!privateKey.isNull() && privateKey.length() == 256, "QSslKey from PEM");

    QSslConfiguration serverConfiguration;
    serverConfiguration.setLocalCertificate(certificate);
    serverConfiguration.setPrivateKey(privateKey);
    QSslServer secureServer;
    secureServer.setSslConfiguration(serverConfiguration);
    secureServer.setHandshakeTimeout(
        120000); // a processor with no help for the cryptography may need longer than the default
    QObject::connect(&secureServer, &QSslServer::errorOccurred, [](QSslSocket *socket, QAbstractSocket::SocketError) {
        std::printf("  (server refused a client: %s)\n", socket->errorString().toUtf8().constData());
    });
    QObject::connect(&secureServer, &QTcpServer::pendingConnectionAvailable, [&secureServer] {
        QTcpSocket *peer = secureServer.nextPendingConnection();
        QObject::connect(peer, &QTcpSocket::readyRead, [peer] { peer->write(peer->readAll()); });
        QObject::connect(peer, &QTcpSocket::disconnected, peer, &QObject::deleteLater);
    });
    check(secureServer.listen(QHostAddress(QString("127.0.0.1")), 4443), "QSslServer::listen");

    const QByteArray secret("hello over TLS");
    QByteArray secureEcho;
    bool encrypted = false;
    QSslConfiguration clientConfiguration;
    clientConfiguration.setCaCertificates({certificate});
    QSslSocket secureClient;
    secureClient.setSslConfiguration(clientConfiguration);
    QObject::connect(&secureClient, &QSslSocket::encrypted, [&] {
        encrypted = true;
        secureClient.write(secret);
    });
    QObject::connect(&secureClient, &QSslSocket::readyRead, [&] { secureEcho += secureClient.readAll(); });
    secureClient.connectToHostEncrypted(QString("127.0.0.1"), 4443, QString("localhost"));

    // A client that trusts no certificate must refuse the same server.
    bool refused = false;
    QSslConfiguration strangerConfiguration;
    strangerConfiguration.setCaCertificates({});
    QSslSocket stranger;
    stranger.setSslConfiguration(strangerConfiguration);
    QObject::connect(&stranger, &QSslSocket::sslErrors, [&](const QList<QSslError> &) { refused = true; });
    QObject::connect(&stranger, &QSslSocket::encrypted, [&] { refused = false; });
    stranger.connectToHostEncrypted(QString("127.0.0.1"), 4443, QString("localhost"));
#endif

    // A worker thread that reports back with a queued call into the main thread's event loop.
    bool workerRan = false;
    bool deliveredOnMainThread = false;
    QThread *mainThread = QThread::currentThread();
    QThread *worker = QThread::create([&] {
        const bool otherThread = QThread::currentThread() != mainThread;
        QMetaObject::invokeMethod(
            &app,
            [&, otherThread] {
                workerRan = otherThread;
                deliveredOnMainThread = QThread::currentThread() == mainThread;
            },
            Qt::QueuedConnection);
    });
    worker->start();

    // Judge what happened once everything has, or after two minutes: the handshakes take a while on an
    // emulated processor, which computes the elliptic curves in software.
    const auto done = [&] {
#ifndef QT_NO_SSL
        if (secureEcho != secret || !refused)
            return false;
#endif
        return echoed == message && workerRan && ticks >= 3;
    };
    QTimer watcher;
    bool finished = false;
    const auto finish = [&] {
        if (finished)
            return;
        finished = true;
        watcher.stop();
        check(ticks >= 3, "QTimer ticks");
        check(echoed == message, "TCP echo over loopback");
        if (echoed != message)
            qWarning() << "  client:" << client.state() << client.errorString() << "server:" << server.errorString();
#ifndef QT_NO_SSL
        check(encrypted, "TLS handshake");
        if (!encrypted)
            qWarning() << "  client:" << secureClient.errorString();
        else
            std::printf("  %s, %s\n", secureClient.sessionCipher().name().toUtf8().constData(),
                        secureClient.sessionCipher().protocolString().toUtf8().constData());
        check(secureEcho == secret, "TLS echo over loopback",
              encrypted ? secureClient.sessionCipher().name() + ", " + secureClient.sessionCipher().protocolString()
                        : QString());
        check(refused, "untrusted certificate refused");
#endif
        check(workerRan, "QThread ran");
        check(deliveredOnMainThread, "queued call from the thread");
        recordFinished();
        std::printf("Nt sample: %s\n", g_failures == 0 ? "PASS" : "FAIL");
        // The web page goes on being served: there is no reason to leave the event loop.
    };
    QObject::connect(&watcher, &QTimer::timeout, [&] {
        if (done())
            finish();
    });
    watcher.start(100);
    QTimer::singleShot(120000, &app, finish);
    const int code = app.exec();
    worker->wait();
    delete worker;
    return code != 0 ? code : g_failures;
}
```

## src/board.cpp
```c
// MIT License - see LICENSE
#include "board.h"

#include <zephyr/kernel.h>
#include <zephyr/net/net_if.h>
#include <zephyr/net/net_l2.h>
#include <zephyr/version.h>

// Symbols of the linker script: the end of what the image takes of the flash, and the limits of its RAM.
extern "C" {
extern char _flash_used[];
extern char _image_ram_start[];
extern char _image_ram_end[];
}

namespace {

// 1498 + 14 bytes of Ethernet header is a multiple of four, which the driver needs (see board.h).
constexpr unsigned short kMtu = 1498;

void limit(struct net_if *iface, void *) {
#if defined(CONFIG_NET_L2_ETHERNET)
    if (net_if_l2(iface) == &NET_L2_GET_NAME(ETHERNET))
        (void)net_if_set_mtu(iface, kMtu);
#else
    (void)iface;
#endif
}

void countThread(const struct k_thread *, void *count) { ++*static_cast<int *>(count); }

const char *cpuName() {
#if defined(CONFIG_CPU_CORTEX_M0)
    return "ARM Cortex-M0";
#elif defined(CONFIG_CPU_CORTEX_M0PLUS)
    return "ARM Cortex-M0+";
#elif defined(CONFIG_CPU_CORTEX_M3)
    return "ARM Cortex-M3";
#elif defined(CONFIG_CPU_CORTEX_M4)
    return "ARM Cortex-M4";
#elif defined(CONFIG_CPU_CORTEX_M7)
    return "ARM Cortex-M7";
#elif defined(CONFIG_CPU_CORTEX_M33)
    return "ARM Cortex-M33";
#elif defined(CONFIG_CPU_CORTEX_A53)
    return "ARM Cortex-A53";
#else
    return CONFIG_ARCH;
#endif
}

const char *architectureName() {
#if defined(CONFIG_CPU_CORTEX_M0) || defined(CONFIG_CPU_CORTEX_M0PLUS)
    return "Armv6-M";
#elif defined(CONFIG_CPU_CORTEX_M3) || defined(CONFIG_CPU_CORTEX_M4) || defined(CONFIG_CPU_CORTEX_M7)
    return "Armv7-M";
#elif defined(CONFIG_CPU_CORTEX_M33)
    return "Armv8-M";
#else
    return CONFIG_ARCH;
#endif
}

} // namespace

void limitEthernetFrames() { net_if_foreach(&limit, nullptr); }

long long uptimeMs() { return k_uptime_get(); }

BoardInfo boardInfo() {
    BoardInfo b{};
    b.cpu = cpuName();
    b.architecture = architectureName();
    b.cores = CONFIG_MP_MAX_NUM_CPUS;
    b.clockHz = CONFIG_SYS_CLOCK_HW_CYCLES_PER_SEC;
#if defined(CONFIG_CPU_HAS_FPU)
    b.fpu = true;
#endif
#if defined(CONFIG_CPU_HAS_ARM_MPU) || defined(CONFIG_CPU_HAS_NXP_SYSMPU)
    b.mpu = true;
#endif
#if defined(CONFIG_QEMU_TARGET)
    b.emulated = true;
#endif
    b.board = CONFIG_BOARD_TARGET;
    b.soc = CONFIG_SOC;

    b.flashSize = static_cast<long long>(CONFIG_FLASH_SIZE) * 1024;
    b.flashUsed = reinterpret_cast<long long>(_flash_used);
    b.ramSize = static_cast<long long>(CONFIG_SRAM_SIZE) * 1024;
    b.ramImage = _image_ram_end - _image_ram_start;
#if defined(CONFIG_COMMON_LIBC_MALLOC_ARENA_SIZE)
    b.libcHeap = CONFIG_COMMON_LIBC_MALLOC_ARENA_SIZE;
#else
    b.libcHeap = -1;
#endif
    b.kernelHeap = CONFIG_HEAP_MEM_POOL_SIZE;
    b.mainStack = CONFIG_MAIN_STACK_SIZE;
    b.mainStackPeak = -1;
#if defined(CONFIG_INIT_STACKS) && defined(CONFIG_THREAD_STACK_INFO)
    size_t unused = 0;
    if (k_thread_stack_space_get(k_current_get(), &unused) == 0)
        b.mainStackPeak = static_cast<long long>(CONFIG_MAIN_STACK_SIZE) - static_cast<long long>(unused);
#endif
    b.isrStack = CONFIG_ISR_STACK_SIZE;
#if defined(CONFIG_NT_THREAD_STACK_SIZE)
    b.threadStack = CONFIG_NT_THREAD_STACK_SIZE;
#else
    b.threadStack = -1;
#endif

    int threads = 0;
    k_thread_foreach(&countThread, &threads);
    b.threads = threads;
    b.tickHz = CONFIG_SYS_CLOCK_TICKS_PER_SEC;

    b.zephyr = KERNEL_VERSION_STRING;
    b.compiler = __VERSION__;
    b.libc = "picolibc";
    b.cppStandard = __cplusplus;

#if defined(CONFIG_NET_PKT_RX_COUNT)
    b.rxPackets = CONFIG_NET_PKT_RX_COUNT;
    b.txPackets = CONFIG_NET_PKT_TX_COUNT;
    b.rxBuffers = CONFIG_NET_BUF_RX_COUNT;
    b.txBuffers = CONFIG_NET_BUF_TX_COUNT;
    b.bufferSize = CONFIG_NET_BUF_DATA_SIZE;
#endif
    return b;
}
```

## src/board.h
```c
// MIT License - see LICENSE
#pragma once

// Board-specific parts of the sample, kept apart from the Qt code because they need the Zephyr headers.

// Sets the MTU of the Ethernet interfaces to 1498, so that Zephyr's driver for the LAN9118 can receive the
// largest frame that results.
//
// Zephyr 4.5's driver for that controller, which QEMU emulates, reads a frame rounded up to whole 32-bit
// words, into a packet whose size Zephyr limits to the MTU plus the 14-byte Ethernet header. A frame of 1514
// bytes, the largest at the usual MTU of 1500, is not a multiple of four, so the last words do not fit; the
// driver then "discards" the frame in a way that leaves the controller stuck, and the board never receives
// another packet. A browser causes this at once: its request, with the cookies it holds for localhost, fills
// a frame. With an MTU of 1498 the largest frame is 1512 bytes, a multiple of four, and every frame fits.
// A board with another Ethernet controller needs none of this.
void limitEthernetFrames();

// What the sample knows about the processor and the resources of the board it runs on. A size or a count that
// is not known is -1.
struct BoardInfo {
    // Processor.
    const char *cpu;          // "ARM Cortex-M3"
    const char *architecture; // "Armv7-M"
    int cores;
    long long clockHz; // of the system clock source
    bool fpu;
    bool mpu;
    bool emulated;     // running under QEMU
    const char *board; // "mps2/an385"
    const char *soc;   // "an385"
    // Memory, in bytes.
    long long flashSize;
    long long flashUsed;
    long long ramSize;
    long long ramImage;   // what the image takes of the RAM, the heaps included
    long long libcHeap;   // arena of malloc(), where Nt allocates from
    long long kernelHeap; // k_malloc(), which holds the stacks of the threads Nt starts
    long long mainStack;
    long long mainStackPeak; // most of it that was ever used
    long long isrStack;
    long long threadStack; // of each thread that Nt starts
    // Kernel.
    int threads;
    int tickHz;
    // Software.
    const char *zephyr;   // "4.5.0"
    const char *compiler; // "14.3.0 (Zephyr SDK 1.0.1)"
    const char *libc;     // "picolibc"
    long cppStandard;     // __cplusplus
    // Network buffers.
    int rxPackets, txPackets;
    int rxBuffers, txBuffers;
    int bufferSize;
};

BoardInfo boardInfo();

// Milliseconds since the kernel started counting, that is since the board was reset.
long long uptimeMs();
```

## src/webpage.cpp
```c
// MIT License - see LICENSE
#include "webpage.h"

#include "board.h"

#include <QtCore/QElapsedTimer>
#include <QtCore/QJsonArray>
#include <QtCore/QJsonObject>
#include <QtCore/QList>

#ifdef CONFIG_NT_HTTPSERVER
#include <QtHttpServer/QHttpServer>
#include <QtNetwork/QNetworkInterface>
#include <QtNetwork/QTcpServer>
#ifndef QT_NO_SSL
#include <QtNetwork/QSslSocket>
#endif
#endif

namespace {

struct Result {
    QString name;
    bool ok;
    QString detail;
};

QList<Result> g_results;
bool g_finished = false;

#ifdef CONFIG_NT_HTTPSERVER

int g_requests = 0;
QElapsedTimer g_uptime;
long long g_servingAtMs = -1; // uptime of the board when the server began to listen

#ifdef CONFIG_BOARD_TARGET
const char kBoard[] = CONFIG_BOARD_TARGET;
#else
const char kBoard[] = "unknown";
#endif

// The primary Nt logo, assets/nt-logo.svg of the repository, unchanged: the brand guide asks for that.
const char kLogo[] =
    R"SVG(<svg xmlns="http://www.w3.org/2000/svg" viewBox="0 0 256 256" width="256" height="256" role="img" aria-label="Nt logo">
<title>Nt</title>
<polygon points="128,24 218,76 218,180 128,232 38,180 38,76" fill="#13977f" stroke="#13977f" stroke-width="24" stroke-linejoin="round"/>
<path fill="#ffffff" d="M57.05 179.38V76.62H86.15L117.35 164.68H119.6V76.62H136.25V179.38H107.75L75.8 91.17H73.7V179.38ZM198.35 118.33H177.65V151.32Q177.65 160.47 179 163.47Q180.35 166.47 185.9 166.47L198.2 166.03L198.95 179.07Q188.9 181.03 183.65 181.03Q170.9 181.03 166.18 175.18Q161.45 169.32 161.45 153.12V118.33H151.85V104.38H161.45V82.62H177.65V104.38H198.35Z"/>
</svg>)SVG";

QString escaped(const QString &text) { return text.toHtmlEscaped(); }

QString duration(qint64 ms) {
    const qint64 s = ms / 1000;
    return s >= 60 ? QString("%1 min %2 s").arg(s / 60).arg(s % 60) : QString("%1 s").arg(s);
}

// A size in bytes, in the largest unit that keeps it readable.
QString size(long long bytes) {
    if (bytes < 0)
        return QString("unknown");
    const auto number = [](double value, long long unit) {
        const bool whole = static_cast<long long>(value * unit) % unit == 0;
        return QString::number(value, 'f', whole ? 0 : 2);
    };
    if (bytes >= 1024 * 1024)
        return number(static_cast<double>(bytes) / (1024 * 1024), 1024 * 1024) + " MiB";
    if (bytes >= 1024)
        return number(static_cast<double>(bytes) / 1024, 1024) + " KiB";
    return QString::number(bytes) + " B";
}

QString cppName(long standard) {
    switch (standard) {
    case 201103L:
        return "C++11";
    case 201402L:
        return "C++14";
    case 201703L:
        return "C++17";
    case 202002L:
        return "C++20";
    default:
        return QString("C++ (%1)").arg(standard);
    }
}

QString row(const QString &label, const QString &value) {
    return QString("<dt>%1</dt><dd>%2</dd>\n").arg(escaped(label), value);
}

// A row with a bar for how much of `total` is `used`.
QString usage(const QString &label, long long used, long long total, const QString &text) {
    const int percent = total > 0 ? static_cast<int>(used * 100 / total) : 0;
    return row(label, QString("<meter min=\"0\" max=\"%1\" value=\"%2\" aria-label=\"%3: %4% used\"></meter>"
                              "<span class=\"fine\">%5 (%4%)</span>")
                          .arg(total)
                          .arg(used)
                          .arg(escaped(label))
                          .arg(percent)
                          .arg(escaped(text)));
}

QString panel(const QString &title, const QString &rows) {
    return QString("<section class=\"panel\">\n<h3>%1</h3>\n<dl>\n%2</dl>\n</section>\n").arg(escaped(title), rows);
}

// What the board is made of, as the program itself finds out: the build configuration, the linker and the kernel.
QString boardSection() {
    const BoardInfo b = boardInfo();

    QString cpu;
    cpu += row("CPU", escaped(QString::fromUtf8(b.cpu)) + "<span class=\"fine\">" +
                          escaped(QString::fromUtf8(b.architecture)) + " architecture</span>");
    cpu += row("Cores", QString::number(b.cores));
    cpu += row("Clock", QString("%1 MHz").arg(b.clockHz / 1000000.0, 0, 'f', b.clockHz % 1000000 == 0 ? 0 : 2));
    cpu += row("Floating point", b.fpu ? "hardware" : "none, in software");
    cpu += row("Memory protection", b.mpu ? "MPU" : "none");
    cpu += row("Board", escaped(QString("%1, SoC %2%3")
                                    .arg(QString::fromUtf8(b.board), QString::fromUtf8(b.soc),
                                         b.emulated ? ", emulated by QEMU" : QString())));
    cpu += row("Kernel tick", QString("%1 Hz").arg(b.tickHz));
    if (g_servingAtMs >= 0)
        cpu +=
            row("Reset to serving", QString("%1 s").arg(g_servingAtMs / 1000.0, 0, 'f', 2) +
                                        "<span class=\"fine\">from the reset of the board to the first listen</span>");

    QString memory;
    memory += usage("Flash", b.flashUsed, b.flashSize, QString("%1 of %2").arg(size(b.flashUsed), size(b.flashSize)));
    memory += usage("RAM", b.ramImage, b.ramSize,
                    QString("%1 of %2, the image with its heaps").arg(size(b.ramImage), size(b.ramSize)));
    memory += row("C library heap",
                  escaped(size(b.libcHeap)) + "<span class=\"fine\">where Nt allocates, with malloc()</span>");
    memory += row("Kernel heap",
                  escaped(size(b.kernelHeap)) + "<span class=\"fine\">the stacks of the threads Nt starts</span>");
    if (b.mainStackPeak >= 0)
        memory += usage("Main stack", b.mainStackPeak, b.mainStack,
                        QString("%1 used at most of %2").arg(size(b.mainStackPeak), size(b.mainStack)));
    else
        memory += row("Main stack", escaped(size(b.mainStack)));
    memory += row("Interrupt stack", escaped(size(b.isrStack)));
    memory +=
        row("Thread stack", escaped(size(b.threadStack)) + "<span class=\"fine\">for each thread Nt starts</span>");
    memory += row("Network buffers", escaped(QString("receive %1, send %2, of %3 each; packets %4 and %5")
                                                 .arg(b.rxBuffers)
                                                 .arg(b.txBuffers)
                                                 .arg(size(b.bufferSize))
                                                 .arg(b.rxPackets)
                                                 .arg(b.txPackets)));

    QString software;
    software += row("Zephyr", escaped(QString::fromUtf8(b.zephyr)));
    software += row("Nt", escaped(QString::fromUtf8(qVersion())));
    software +=
        row("Compiler", escaped(QString("GCC %1, %2").arg(QString::fromUtf8(b.compiler), cppName(b.cppStandard))));
    software += row("C library", escaped(QString::fromUtf8(b.libc)));
#ifndef QT_NO_SSL
    software += row("TLS", escaped(QSslSocket::sslLibraryVersionString()));
#endif
    software += row("Kernel threads", QString::number(b.threads));

    QString network;
    for (const QNetworkInterface &i : QNetworkInterface::allInterfaces()) {
        QStringList parts;
        if (!i.hardwareAddress().isEmpty())
            parts << i.hardwareAddress();
        parts << QString("MTU %1").arg(i.maximumTransmissionUnit());
        for (const QNetworkAddressEntry &a : i.addressEntries())
            parts << QString("%1/%2").arg(a.ip().toString()).arg(a.prefixLength());
        network += row(i.name(), escaped(parts.join(" \u00b7 ")));
    }
    if (network.isEmpty())
        network = row("Interfaces", "none");

    return "<h2>The board</h2>\n<div class=\"panels\">\n" + panel("Processor", cpu) + panel("Memory", memory) +
           panel("Software", software) + panel("Network", network) + "</div>\n";
}

QString page() {
    int passed = 0;
    QString rows;
    for (const Result &r : g_results) {
        passed += r.ok ? 1 : 0;
        rows += QString("<tr><td>%1</td><td class=\"%2\">%3</td><td class=\"note\">%4</td></tr>\n")
                    .arg(escaped(r.name), r.ok ? "ok" : "bad", r.ok ? "passed" : "FAILED", escaped(r.detail));
    }
    if (g_results.isEmpty())
        rows = "<tr><td colspan=\"3\" class=\"note\">No check has finished yet.</td></tr>\n";
    const bool failed = passed != g_results.size();
    const QString state = !g_finished ? "running the self-checks" : failed ? "some checks failed" : "all checks passed";

    return QString(R"(<!doctype html>
<html lang="en">
<head>
<meta charset="utf-8">
<meta name="viewport" content="width=device-width, initial-scale=1">
<meta http-equiv="refresh" content="%1">
<link rel="icon" type="image/svg+xml" href="/logo.svg">
<title>Nt on Zephyr</title>
<style>
:root { color-scheme: light dark; --bg: #f4f7f7; --card: #ffffff; --ink: #14272b; --muted: #567075; --line: #d5e0e1;
        --accent: #13977f; --ok: #14804a; --bad: #b3261e; }
@media (prefers-color-scheme: dark) {
  :root { --bg: #0e1a1c; --card: #152427; --ink: #e5f0f0; --muted: #93abae; --line: #26393c; --accent: #3fd9b4;
          --ok: #4cc38a; --bad: #ff8a80; }
}
* { box-sizing: border-box; }
body { margin: 0; background: var(--bg); color: var(--ink); font: 16px/1.5 system-ui, -apple-system, "Segoe UI", sans-serif; }
main { max-width: 760px; margin: 0 auto; padding: 40px 16px 56px; }
header { display: flex; align-items: center; gap: 18px; margin: 0 0 6px; }
header img { flex: none; width: 64px; height: 64px; }
h1 { margin: 0; font-size: 2rem; line-height: 1.2; letter-spacing: -0.02em; }
h1 span { color: var(--accent); }
.sub { margin: 0 0 28px; color: var(--muted); }

.cards { display: grid; grid-template-columns: repeat(auto-fit, minmax(160px, 1fr)); gap: 12px; margin-bottom: 32px; }
.card { background: var(--card); border: 1px solid var(--line); border-radius: 12px; padding: 14px 16px; }
.card b { display: block; font-size: 1.15rem; word-break: break-word; }
.card small { color: var(--muted); }
h2 { font-size: 1.1rem; margin: 0 0 10px; }
.panels { align-items: start; display: grid; grid-template-columns: repeat(auto-fit, minmax(330px, 1fr)); gap: 12px; margin-bottom: 32px; }
.panel { background: var(--card); border: 1px solid var(--line); border-radius: 12px; padding: 14px 16px; }
.panel h3 { margin: 0 0 8px; font-size: 0.8rem; text-transform: uppercase; letter-spacing: 0.06em; color: var(--muted); }
dl { display: grid; grid-template-columns: max-content 1fr; gap: 6px 16px; margin: 0; font-size: 0.92rem; }
dt { color: var(--muted); }
dd { margin: 0; min-width: 0; overflow-wrap: anywhere; }
dd .fine { display: block; color: var(--muted); font-size: 0.82rem; }
meter { display: block; width: 100%; height: 8px; margin: 5px 0 2px; accent-color: var(--accent); }
table { width: 100%%; border-collapse: collapse; background: var(--card); border: 1px solid var(--line);
        border-radius: 12px; overflow: hidden; }
td { padding: 10px 14px; border-top: 1px solid var(--line); }
tr:first-child td { border-top: 0; }
td.ok { color: var(--ok); font-weight: 600; }
td.bad { color: var(--bad); font-weight: 700; }
td.note { color: var(--muted); font-size: 0.9rem; }
.state { display: inline-block; margin: 0 0 12px; padding: 2px 12px; border-radius: 99px; font-size: 0.9rem;
         border: 1px solid var(--line); background: var(--card); }
footer { margin-top: 32px; color: var(--muted); font-size: 0.9rem; }
a { color: var(--accent); }
</style>
</head>
<body>
<main>
<header>
<img src="/logo.svg" alt="Nt logo" width="64" height="64">
<h1>Hello from <span>Nt</span> on Zephyr</h1>
</header>
<p class="sub">This page is served by Nt HTTP Server, from a C++ program on the Zephyr RTOS running in an emulated board.</p>
<div class="cards">
<div class="card"><small>Board</small><b>%2</b></div>
<div class="card"><small>Nt</small><b>%3</b></div>
<div class="card"><small>Up for</small><b>%4</b></div>
<div class="card"><small>Page views</small><b>%5</b></div>
</div>
%10
<h2>Self-checks</h2>
<div class="state">%6: %7 of %8 so far</div>
<table>
%9</table>
<footer>The same data as JSON: <a href="/api/status">/api/status</a>. The page refreshes every few seconds.</footer>
</main>
</body>
</html>
)")
        .arg(g_finished ? 30 : 5)
        .arg(escaped(QString::fromUtf8(kBoard)), escaped(QString::fromUtf8(qVersion())), duration(g_uptime.elapsed()))
        .arg(g_requests)
        .arg(state)
        .arg(passed)
        .arg(g_results.size())
        .arg(rows)
        .arg(boardSection());
}

QJsonObject status() {
    QJsonArray checks;
    for (const Result &r : g_results)
        checks.append(QJsonObject{{"name", r.name}, {"ok", r.ok}, {"detail", r.detail}});
    const BoardInfo b = boardInfo();
    const QJsonObject hardware{{"cpu", QString::fromUtf8(b.cpu)},
                               {"architecture", QString::fromUtf8(b.architecture)},
                               {"cores", b.cores},
                               {"clockHz", b.clockHz},
                               {"fpu", b.fpu},
                               {"mpu", b.mpu},
                               {"emulated", b.emulated},
                               {"soc", QString::fromUtf8(b.soc)},
                               {"flashBytes", b.flashSize},
                               {"flashUsedBytes", b.flashUsed},
                               {"ramBytes", b.ramSize},
                               {"ramImageBytes", b.ramImage},
                               {"libcHeapBytes", b.libcHeap},
                               {"kernelHeapBytes", b.kernelHeap},
                               {"mainStackBytes", b.mainStack},
                               {"mainStackPeakBytes", b.mainStackPeak},
                               {"isrStackBytes", b.isrStack},
                               {"threadStackBytes", b.threadStack},
                               {"threads", b.threads},
                               {"zephyr", QString::fromUtf8(b.zephyr)}};
    return QJsonObject{{"board", QString::fromUtf8(kBoard)},
                       {"hardware", hardware},
                       {"nt", QString::fromUtf8(qVersion())},
                       {"uptimeMs", g_uptime.elapsed()},
                       {"resetToServingMs", g_servingAtMs},
                       {"pageViews", g_requests},
                       {"finished", g_finished},
                       {"checks", checks}};
}

#endif // CONFIG_NT_HTTPSERVER

} // namespace

void recordResult(const QString &name, bool ok, const QString &detail) { g_results.append({name, ok, detail}); }

void recordFinished() { g_finished = true; }

bool startWebServer(quint16 port, QString *error) {
#ifdef CONFIG_NT_HTTPSERVER
    g_uptime.start();
    auto *server = new QHttpServer;
    server->route("/", [] {
        ++g_requests;
        return QHttpServerResponse("text/html; charset=utf-8", page().toUtf8());
    });
    server->route("/logo.svg", [] { return QHttpServerResponse("image/svg+xml", QByteArray(kLogo)); });
    server->route("/api/status", [] { return QHttpServerResponse(status()); });
    server->route("/hello/<arg>", [](const QString &name) { return QString("Hello, %1!\n").arg(name); });

    auto *tcp = new QTcpServer(server);
    if (!tcp->listen(QHostAddress::AnyIPv4, port) || !server->bind(tcp)) {
        *error = tcp->errorString();
        delete server;
        return false;
    }
    g_servingAtMs = uptimeMs();
    return true;
#else
    Q_UNUSED(port);
    *error = QString("this build has no HTTP server (CONFIG_NT_HTTPSERVER)");
    return false;
#endif
}
```

## src/webpage.h
```c
// MIT License - see LICENSE
#pragma once

#include <QtCore/qglobal.h>
#include <QtCore/qstring.h>

// The web page of the sample: what Nt HTTP Server serves from the emulated board. The page lists the results of
// the self-checks as they come in, with a few facts about the board, and refreshes itself.

// Records the result of a check for the page.
void recordResult(const QString &name, bool ok, const QString &detail = QString());
// Tells the page that all checks are done.
void recordFinished();
// Starts serving on `port`. Returns false, with a message, if that is not possible or the build has no HTTP server.
bool startWebServer(quint16 port, QString *error);
```
